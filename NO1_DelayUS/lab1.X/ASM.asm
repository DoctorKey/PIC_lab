;*******************************************************************************
; 标    题: PIC_ST_V3.0学习板演示程序--延时1微秒
; 文 件 名: Delay_US
; 建立日期: 2013.7.2
; 修改日期: 2013.7.2
; 版    本: V1.0
; 作    者: zyixin
;********************************************************************************
; 跳线接法：
; 功能描述: 延时1微秒
;*******************************************************************************
;【版权】Copyright(C) 2009-2019 All Rights Reserved
;【声明】此程序仅用于学习与参考，引用请注明版权和作者信息！
;******************************************************************************/

 list		p=16f877A	; 标明所用的处理器类型
 #include	"p16f877A.inc"	; 调用头文件	
; CONFIG
; __config 0x3F7A
 __CONFIG _FOSC_HS & _WDTE_OFF & _PWRTE_OFF & _BOREN_ON & _LVP_OFF & _CPD_OFF & _WRT_OFF & _CP_OFF

;***** 变量声明*******************************************************
L1       EQU  0x70                       ;延时函数循环变量           
;**********************************************************************
	org         0x0000            ; 复位入口地址
  
;-------------------------------------------------Main的代码-----------------------------------------------------------------
main                                                 
         banksel  TRISB;		;切换到TRISB所在的bank(bank1)
         bcf           TRISB, RB0;	;确保RB0为输出状态
         banksel  PORTB;		;切换到PORTB所在的bank(bank0)
Loop
          bsf          PORTB, RB0;
          movlw  .100;
          call         DelayUS;
          bcf          PORTB, RB0;
          movlw  .100;
          call         DelayUS;
          goto       Loop              ;  
;------------------------------------------------------------------子函数------------------------------------------------------------------------------
;**************DelayUS**************
DelayUS                                 ; 延时x毫微秒，x由变量w寄存器设定
          movwf   L1                 ;
LL1US        
          nop                               ;
          nop                               ;
          decfsz    L1, f             ;          
          goto        LL1US         ;
          return                         ;
;-------------------------------------------------------------------------------------------
END                                        ; 程序结束
